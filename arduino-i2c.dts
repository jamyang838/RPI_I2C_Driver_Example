/dts-v1/;
/plugin/;

/*
/{
    compatible = "brcm, bcm2835";
}
*/

&i2c1 {
    #address-cells = <0x01>;
    #size-cells = <0x00>;
    arduino-i2c@8 {
        compatible = "arduino-i2c";
        reg = <0x8>;
        status = "okay";
    };
};

